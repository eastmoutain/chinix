## Kconfig
```kconfig
mainmenu "Chinix Configuration"

menu "Build Setup"

choice
    prompt "Build platform"
    default LINUX_HOST

config LINUX_HOST
    bool "Linux"

endchoice

endmenu # Build Setup



menu "Kernel Configuartion"
source "kernel/Kconfig"
endmenu # Kernel Configuration

menu "Debug Options"
config DEBUG_ASSERT
    bool "debug assert"
    default n
    ---help---
        Enable or disable debug assertion

endmenu # Debug Options
```

## kernel/Kconfig
```kconfig
config VERSION
	string "Chinix version"
    default "0.1"
	---help---
		Show Chinix version

config MAX_THREADS
    int "Max threads supported by Chinix" 
    default 10
    ---help---
        The max number of threads supported by Chinix

config DEFAULT_THREAD_STACK_SIZE
    hex "default thread stack size"
    default 0x1000
    ---help---
        default thread stack size
```
